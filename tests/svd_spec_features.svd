# TestDevice register map
Vendor: TestVendor; Series: TestSeries; File version: 1.0
Test device exercising CMSIS-SVD spec features that simple vendor files don't exercise: multiple addressBlocks per peripheral, non-numeric dimIndex labels, repeated Reserved field names, isDefault enumeratedValues, and binary-literal enumeratedValue values.
CPU: CM4 r0p1, little endian, no MPU, FPU, 4 interrupt priority bits
Registers are 16-bit, read-write, reset 0x0 unless marked. A register's access mark holds for its fields unless they carry their own. Offsets are from the block's base; lines under a group give offsets from that group; [hi:lo] are bit positions; {n}, {i} and the like mark numbered series; 'fields as' and 'values as' point back to an identical list; <NAME> marks a mode.

## Memory map
0x40003000 MULTIBLOCK_PERIPH blocks up to offset 0x1008 — A peripheral with multiple disjoint addressBlocks.

## MULTIBLOCK_PERIPH — A peripheral with multiple disjoint addressBlocks.
Base 0x40003000
0x00 SCKDIVCR 32-bit — System Clock Division Control Register.
  [30:28] FCK — Flash IF Clock Select
    0=DIV1 (/1); 1=DIV2 (/2); other=others (Setting prohibited)
0x1000 BUSMCNT{x} (x=M4I,M4D,SYS,DMA; step 0x4) — Master Bus Control Register {x}
  [15] IERES — Ignore Error Responses
